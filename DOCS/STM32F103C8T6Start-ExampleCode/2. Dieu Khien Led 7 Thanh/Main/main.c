/**
  ******************************************************************************
  * Ten Tep		:		    main.c
  * Tac Gia		:	  		Nguyen Quy Nhat
  * Cong Ty		:			  MinhHaGroup
  *	Website 	:			  MinhHaGroup.com
  * Phien Ban	:			  V1.0.0
  * Ngay		  :    		31-07-2012
  * Tom Tat   :       Dinh nghia ham main.           			
  *           
  *
  ******************************************************************************
  * Chu Y		:
  *							 
  ******************************************************************************
  */
#include "main.h"
#include "var.h" 
void LED7_InBuffer(uint8_t Point)
{
	BufferLed7[3]  = CHU_SO[(Point++)%10]; 
	BufferLed7[2]  = CHU_SO[(Point++)%10]; 
	BufferLed7[1]  = CHU_SO[(Point++)%10]; 
	BufferLed7[0]  = CHU_SO[(Point++)%10]; 
}
void LED7_CacuCode(uint16_t Number)
{
	int8_t i;
    for(i=0;i<4;i++)
    {  	
		BufferLed7[i]=CHU_SO[Number%10];
		Number=Number/10;
	}
	for(i=3;i>=0;i--)
	{
		if(BufferLed7[i]!=CHU_SO[0])
		break;
		BufferLed7[i]=0xff;
	}
}
void Led7OnOneLed(uint8_t Point)
{
	uint16_t TempPoint=0x8000;
	TempPoint>>=Point;
	LED7_ADDR_PORT|=0xf000;
	LED7_DATA_PORT|=0x00ff;
	LED7_ADDR_PORT&=(~TempPoint);
	LED7_DATA_PORT&=(0xff00|BufferLed7[Point]);
	
}
void LED7_Display(uint16_t Value)
{  
	  int8_t i;
    for(i=0;i<4;i++)
    {
				Led7OnOneLed(i);   
        delay_ms(1);			
    }    
}

/*********************************EXTERN VARIABLE***********************************/ 
int main(void)
{
/***********************************BIEN CUC BO*************************************/
	uint8_t i,j;
/***********************************SYSTEM******************************************/
SystemInit();

/************************************NVIC*******************************************/
//NVIC_Configuration();
						
/************************************GPIO*******************************************/
GPIO_Configuration();

/************************************TIMER*******************************************/
//+++++++++++++++++++++++++++++++++++TIMER1+++++++++++++++++++++++++++++++++++++++++++
//TIMER1_Configuration();

//+++++++++++++++++++++++++++++++++++TIMER2+++++++++++++++++++++++++++++++++++++++++++
//TIMER2_Configuration();

//+++++++++++++++++++++++++++++++++++TIMER3+++++++++++++++++++++++++++++++++++++++++++
//TIMER3_Configuration();	

/************************************DMA********************************************/
//+++++++++++++++++++++++++++++++++++DMA1+++++++++++++++++++++++++++++++++++++++++++
//DMA1_Configuration();

//+++++++++++++++++++++++++++++++++++DMA2+++++++++++++++++++++++++++++++++++++++++++
//DMA1_Configuration();

/************************************ADC********************************************/
//++++++++++++++++++++++++++++++++++ADC1+++++++++++++++++++++++++++++++++++++++++++
//ADC1_Configuration();

//+++++++++++++++++++++++++++++++++ADC2+++++++++++++++++++++++++++++++++++++++++++
//ADC2_Configuration();	

//+++++++++++++++++++++++++++++++++ADC3++++++++++++++++++++++++++++++++++++++++++
//ADC3_Configuration();

/************************************USART********************************************/
//+++++++++++++++++++++++++++++++++USART1++++++++++++++++++++++++++++++++++++++++++
// USART1_Configuration();
	
//+++++++++++++++++++++++++++++++++USART2++++++++++++++++++++++++++++++++++++++++++
//+++++++++++++++++++++++++++++++++USART3++++++++++++++++++++++++++++++++++++++++++
//+++++++++++++++++++++++++++++++++USART4++++++++++++++++++++++++++++++++++++++++++
/****************************** USER FUNCITION *************************************/	
  delay_init(72);
/*++++++++++++++++++++++++++++++++++++++++++++++++++++++++++++++++++++++++++++++++++
								 EXCUTION
++++++++++++++++++++++++++++++++++++++++++++++++++++++++++++++++++++++++++++++++++*/

/****************************************************************************
****************************************************************************/ 	            	            				
while(1)
 {	
			for(i=0;i<10;i++)
			{
				LED7_InBuffer(i);	
				for(j=0;j<100;j++)
				{
						LED7_Display(0);
				}
			}			
 }
}
/******************* (C) COPYRIGHT 2012 Nguyen Quy Nhat *****END OF FILE****/

